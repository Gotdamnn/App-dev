/*
  ==============================================================================
  PatientPulse ESP32 - MLX90614 Infrared Temperature Sensor (WITH LOGO)
  ==============================================================================
  
  Uses:
  - MLX90614 non-contact infrared temperature sensor
  - SH1107 128x128 OLED display
  - WiFi connectivity to PatientPulse backend
  
  Features:
  - PatientPulse logo splash screen on startup
  - Real-time temperature display
  - Automatic status classification (Normal/Warning/Fever/Low)
  - Sends data to PatientPulse API every 2 seconds
  - Optional patient linking
  - Connection status indicator
  
==============================================================================
*/

#include <WiFi.h>
#include <HTTPClient.h>
#include <Wire.h>
#include <Adafruit_SH110X.h>
#include <Adafruit_MLX90614.h>

// ===== CONFIGURATION =====
// WiFi Credentials
const char* ssid = "bumili ka ng wifi mo";
const char* password = "Carlzabala@123";

// PatientPulse Server Configuration
const char* serverDomain = "192.168.1.100";  // <<<< CHANGE THIS to your server IP
const int serverPort = 3001;
const char* deviceId = "1";  // Device ID from database (from device registration)

// Optional: Patient ID for linking readings to a specific patient
// Set to -1 if readings are not linked to a specific patient
const int patientId = -1;  // Change to patient ID (1, 2, 3, etc.) to auto-update patient temperature

// ===== DISPLAY SETTINGS =====
#define SCREEN_WIDTH 128
#define SCREEN_HEIGHT 128
#define OLED_ADDR 0x3C

// I2C Pins for OLED (Bus 0)
#define OLED_SDA_PIN 18
#define OLED_SCL_PIN 16

// I2C Pins for MLX90614 (Bus 1)
#define MLX_SDA_PIN 21
#define MLX_SCL_PIN 22

// ===== I2C INSTANCES =====
TwoWire I2C_OLED = TwoWire(0);  // Bus 0 for OLED
TwoWire I2C_MLX = TwoWire(1);   // Bus 1 for MLX90614

// ===== SENSOR & DISPLAY OBJECTS =====
Adafruit_SH1107 display = Adafruit_SH1107(SCREEN_WIDTH, SCREEN_HEIGHT, &I2C_OLED);
Adafruit_MLX90614 mlx = Adafruit_MLX90614();

// ===== TIMING =====
unsigned long previousMillis = 0;
const long interval = 2000;  // Send data every 2 seconds

// ===== STATUS VARIABLES =====
String lastStatus = "";
float lastTemperature = 0.0;
bool isWiFiConnected = false;

// ===== LOGO BITMAP (128x128 pixels) =====
const unsigned char logoBitmap[] PROGMEM = {
   0xff, 0xff, 0xff, 0xff, 0xff, 0xff, 0xff, 0xff, 0xff, 0xff, 0xff, 0xff, 0xff, 0xff, 0xff, 0xff,
   0xff, 0xff, 0xff, 0xff, 0xff, 0xff, 0xff, 0xff, 0xff, 0xff, 0xff, 0xff, 0xff, 0xff, 0xff, 0xff,
   0xff, 0xff, 0xff, 0xff, 0xff, 0xff, 0xff, 0xff, 0xff, 0xff, 0xff, 0xff, 0xff, 0xff, 0xff, 0xff,
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   0xff, 0xff, 0xff, 0xff, 0xff, 0xff, 0xff, 0xff, 0xff, 0xff, 0xff, 0xff, 0xff, 0xff, 0xff, 0xff,
};

// ===== FUNCTION PROTOTYPES =====
void setupDisplay();
void setupSensor();
void setupWiFi();
void connectToWiFi();
void updateSensorReadings();
void sendTemperatureToAPI(float tempC, String status);
String classifyTemperature(float tempC);
void displayTemperatureScreen(float tempC, String status);
void displaySplashScreen();
void scanI2CBus(const char* busName, TwoWire& wire);

void scanI2CBus(const char* busName, TwoWire& wire) {
    Serial.print("Scanning ");
    Serial.print(busName);
    Serial.println("...");
    
    int count = 0;
    for (byte address = 1; address < 127; address++) {
        wire.beginTransmission(address);
        byte error = wire.endTransmission();
        
        if (error == 0) {
            Serial.print("  ✓ Found device at 0x");
            if (address < 16) Serial.print("0");
            Serial.println(address, HEX);
            count++;
        }
    }
    
    if (count == 0) {
        Serial.println("  ✗ No devices found!");
    }
}

// ==============================================================================
void setup() {
    Serial.begin(115200);
    delay(1000);
    
    Serial.println("\n\n=== PatientPulse MLX90614 Temperature Monitor ===\n");
    
    // Initialize I2C Bus 0 (OLED on GPIO 18, 16)
    Serial.print("Initializing I2C Bus 0 (OLED)...");
    pinMode(OLED_SDA_PIN, INPUT_PULLUP);  // Enable internal pull-ups
    pinMode(OLED_SCL_PIN, INPUT_PULLUP);
    I2C_OLED.begin(OLED_SDA_PIN, OLED_SCL_PIN, 100000);
    Serial.println(" ✓");
    
    // Initialize I2C Bus 1 (MLX90614 on GPIO 21, 22)
    Serial.print("Initializing I2C Bus 1 (MLX90614)...");
    pinMode(MLX_SDA_PIN, INPUT_PULLUP);  // Enable internal pull-ups
    pinMode(MLX_SCL_PIN, INPUT_PULLUP);
    I2C_MLX.begin(MLX_SDA_PIN, MLX_SCL_PIN, 100000);
    Serial.println(" ✓");
    
    // Scan both I2C buses to see what devices are connected
    Serial.println("\n=== I2C Device Scan ===");
    delay(100);
    scanI2CBus("I2C Bus 0 (OLED pins GPIO 18, 16)", I2C_OLED);
    delay(100);
    scanI2CBus("I2C Bus 1 (MLX90614 pins GPIO 21, 22)", I2C_MLX);
    Serial.println();
    
    // Initialize display
    Serial.print("Initializing OLED display...");
    setupDisplay();
    Serial.println(" ✓");
    
    // Show splash screen with logo
    displaySplashScreen();
    delay(3000);  // Show for 3 seconds
    
    // Initialize temperature sensor
    Serial.print("Initializing MLX90614 sensor...");
    setupSensor();
    Serial.println(" ✓");
    
    // Initialize WiFi
    Serial.print("Initializing WiFi...");
    setupWiFi();
    Serial.println(" ✓");
    
    // Connect to WiFi
    connectToWiFi();
    
    Serial.println("\n=== Initialization Complete ===\n");
}

// ==============================================================================
void loop() {
    // Check WiFi connection status
    if (WiFi.status() != WL_CONNECTED) {
        isWiFiConnected = false;
        if (millis() % 10000 < 500) {  // Try reconnect every 10 seconds
            Serial.println("WiFi disconnected. Attempting to reconnect...");
            connectToWiFi();
        }
    } else {
        isWiFiConnected = true;
    }
    
    // Update sensor readings and send data at interval
    unsigned long currentMillis = millis();
    if (currentMillis - previousMillis >= interval) {
        previousMillis = currentMillis;
        updateSensorReadings();
    }
    
    delay(100);  // Small delay to prevent watchdog timeout
}

// ==============================================================================
void setupDisplay() {
    if (!display.begin(OLED_ADDR, false)) {
        Serial.println("SSD1107 allocation failed");
        while (1) delay(10);
    }
    
    display.clearDisplay();
    display.setTextSize(1);
    display.setTextColor(SH110X_WHITE);
    display.setCursor(0, 0);
    display.println("PatientPulse");
    display.println("Initializing...");
    display.display();
}

// ==============================================================================
void displaySplashScreen() {
    display.clearDisplay();
    
    // Draw the logo bitmap (128x128)
    display.drawBitmap(0, 0, logoBitmap, SCREEN_WIDTH, SCREEN_HEIGHT, SH110X_WHITE);
    
    display.display();
}

// ==============================================================================
void setupSensor() {
    // Try default address first
    if (!mlx.begin(0x5A, &I2C_MLX)) {
        // If default fails, try detected address 0x01
        Serial.println("Warning: MLX90614 not found at 0x5A, trying 0x01...");
        if (!mlx.begin(0x01, &I2C_MLX)) {
            display.clearDisplay();
            display.setTextSize(1);
            display.setTextColor(SH110X_WHITE);
            display.setCursor(0, 0);
            display.println("ERROR: MLX90614");
            display.println("Sensor Not Found");
            display.println("Found device at 0x01");
            display.println("Not an MLX90614");
            display.display();
        
            Serial.println("\nERROR: MLX90614 sensor not detected at 0x5A or 0x01!");
            Serial.println("Device ON BUS 1:");
            Serial.println("  Found at: 0x01");
            Serial.println("  Expected MLX90614 at: 0x5A");
            Serial.println("\nPossible issues:");
            Serial.println("  1. Wrong sensor module (not MLX90614?)");
            Serial.println("  2. Sensor is damaged");
            Serial.println("  3. Check sensor model number");
            
            while (1) delay(1000);
        }
    }

// ==============================================================================
void setupWiFi() {
    WiFi.mode(WIFI_STA);
    
    // Scan networks
    int numNetworks = WiFi.scanNetworks();
    Serial.println("\nFound " + String(numNetworks) + " WiFi networks:");
    for (int i = 0; i < min(numNetworks, 5); i++) {
        Serial.println("  [" + String(i + 1) + "] " + WiFi.SSID(i) + 
                      " (Signal: " + String(WiFi.RSSI(i)) + " dBm)");
    }
}

// ==============================================================================
void connectToWiFi() {
    display.clearDisplay();
    display.setTextSize(1);
    display.setTextColor(SH110X_WHITE);
    display.setCursor(0, 0);
    display.println("PatientPulse");
    display.println("Connecting to WiFi...");
    display.println(ssid);
    display.display();
    
    WiFi.begin(ssid, password);
    
    int attempts = 0;
    const int MAX_ATTEMPTS = 20;
    
    Serial.print("Connecting to WiFi: " + String(ssid));
    
    while (WiFi.status() != WL_CONNECTED && attempts < MAX_ATTEMPTS) {
        delay(500);
        Serial.print(".");
        display.clearDisplay();
        display.setTextSize(1);
        display.setTextColor(SH110X_WHITE);
        display.setCursor(0, 20);
        display.println("Connecting...");
        display.println("Attempt: " + String(attempts + 1) + "/" + String(MAX_ATTEMPTS));
        display.display();
        attempts++;
    }
    Serial.println();
    
    if (WiFi.status() == WL_CONNECTED) {
        isWiFiConnected = true;
        Serial.println("✓ WiFi Connected!");
        Serial.println("IP Address: " + WiFi.localIP().toString());
        Serial.println("Signal Strength: " + String(WiFi.RSSI()) + " dBm");
        
        display.clearDisplay();
        display.setTextSize(1);
        display.setTextColor(SH110X_WHITE);
        display.setCursor(0, 0);
        display.println("✓ WiFi Connected");
        display.println("IP: " + WiFi.localIP().toString());
        display.println("Signal: " + String(WiFi.RSSI()) + " dBm");
        display.println("");
        display.println("Device ID: " + String(deviceId));
        if (patientId != -1) {
            display.println("Patient ID: " + String(patientId));
        }
        display.println("");
        display.println("Ready!");
        display.display();
        delay(2000);
    } else {
        isWiFiConnected = false;
        Serial.println("✗ Failed to connect to WiFi after " + String(MAX_ATTEMPTS) + " attempts");
        Serial.println("Check SSID and Password:");
        Serial.println("  SSID: " + String(ssid));
        Serial.println("  Password: " + String(password));
        Serial.println("  WiFi router in range?");
        
        display.clearDisplay();
        display.setTextSize(1);
        display.setTextColor(SH110X_WHITE);
        display.setCursor(0, 0);
        display.println("✗ WiFi Failed");
        display.println("Check:");
        display.println("  SSID: " + String(ssid));
        display.println("  Password");
        display.println("  Router power");
        display.println("  Distance to router");
        display.display();
        
        // Don't get stuck - continue operation offline
        Serial.println("Continuing offline mode...");
    }
}

// ==============================================================================
String classifyTemperature(float tempC) {
    if (tempC < 36.5) {
        return "Low";
    } else if (tempC >= 36.5 && tempC <= 37.5) {
        return "Normal";
    } else if (tempC >= 37.6 && tempC <= 38.4) {
        return "Warning";
    } else if (tempC >= 38.5) {
        return "Fever";
    }
    return "Unknown";
}

// ==============================================================================
void updateSensorReadings() {
    // Read temperature from MLX90614
    float tempC = mlx.readObjectTempC();
    
    // Validate reading
    if (isnan(tempC) || tempC < 30.0 || tempC > 45.0) {
        Serial.println("✗ Invalid temperature reading!");
        display.clearDisplay();
        display.setTextSize(1);
        display.setTextColor(SH110X_WHITE);
        display.setCursor(0, 60);
        display.println("Sensor Error!");
        display.display();
        return;
    }
    
    // Classify temperature
    String status = classifyTemperature(tempC);
    
    // Store values for display
    lastTemperature = tempC;
    lastStatus = status;
    
    // Display on OLED
    displayTemperatureScreen(tempC, status);
    
    // Send to API
    sendTemperatureToAPI(tempC, status);
}

// ==============================================================================
void displayTemperatureScreen(float tempC, String status) {
    display.clearDisplay();
    
    // Header
    display.setTextSize(1);
    display.setTextColor(SH110X_WHITE);
    display.setCursor(15, 5);
    display.println("BODY TEMPERATURE");
    
    // WiFi & Status line
    display.setCursor(15, 15);
    display.print("Status: ");
    display.println(isWiFiConnected ? "ONLINE" : "OFFLINE");
    
    // Divider line
    display.drawFastHLine(0, 25, 128, SH110X_WHITE);
    
    // Temperature display (large)
    display.setTextSize(3);
    display.setTextColor(SH110X_WHITE);
    display.setCursor(10, 45);
    display.print(tempC, 1);
    display.setTextSize(2);
    display.write(247);  // Degree symbol
    display.print("C");
    
    // Status classification box
    display.fillRect(0, 100, 128, 28, SH110X_WHITE);
    display.setTextColor(SH110X_BLACK);
    display.setTextSize(2);
    display.setCursor(25, 106);
    display.println(status);
    
    display.display();
}

// ==============================================================================
void sendTemperatureToAPI(float tempC, String status) {
    if (!isWiFiConnected) {
        Serial.println("⚠ WiFi not connected. Data not sent.");
        return;
    }
    
    HTTPClient http;
    
    // Build the API URL
    String apiUrl = "http://" + String(serverDomain) + ":" + String(serverPort) + 
                    "/api/devices/" + String(deviceId) + "/vitals";
    
    Serial.print("Sending POST to: ");
    Serial.println(apiUrl);
    
    http.begin(apiUrl);
    http.addHeader("Content-Type", "application/json");
    
    // Calculate signal strength (convert RSSI to percentage)
    int rssi = WiFi.RSSI();
    int signalStrength = map(rssi, -100, -30, 0, 100);
    signalStrength = constrain(signalStrength, 0, 100);
    
    // Build JSON payload
    String payload = "{";
    payload += "\"body_temperature\": " + String(tempC, 2) + ",";
    payload += "\"temperature_status\": \"" + status + "\",";
    payload += "\"connection_status\": \"online\",";
    payload += "\"signal_strength\": " + String(signalStrength);
    
    // Add patient_id if configured
    if (patientId != -1) {
        payload += ",\"patient_id\": " + String(patientId);
    }
    
    payload += "}";
    
    Serial.println("Payload: " + payload);
    
    // Send POST request
    int httpResponseCode = http.POST(payload);
    
    if (httpResponseCode > 0) {
        String response = http.getString();
        
        if (httpResponseCode == 201 || httpResponseCode == 200) {
            Serial.print("✓ Success (");
            Serial.print(httpResponseCode);
            Serial.println(")");
            Serial.println("Response: " + response.substring(0, 100));
        } else {
            Serial.print("✗ Server error (");
            Serial.print(httpResponseCode);
            Serial.println(")");
            Serial.println("Response: " + response.substring(0, 100));
        }
        
        // Log temperature and status
        Serial.print("Temperature: ");
        Serial.print(tempC);
        Serial.print("°C | Status: ");
        Serial.print(status);
        Serial.print(" | Signal: ");
        Serial.print(signalStrength);
        Serial.println("%");
        
    } else {
        Serial.print("✗ Request failed: ");
        Serial.println(http.errorToString(httpResponseCode).c_str());
    }
    
    http.end();
}
